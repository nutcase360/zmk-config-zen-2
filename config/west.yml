## config/west.yml
```yaml
manifest:
  remotes:
    - name: zmkfirmware
      url-base: https://github.com/zmkfirmware
    - name: caksoylar
      url-base: https://github.com
  projects:
    - name: zmk
      remote: caksoylar
      revision: zen-v1+v2
      import: app/west.yml
  self:
    path: config
```
